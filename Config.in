## Config.in
```kconfig
menu "Packages source location"

config BR2_ARM_TRUSTED_FIRMWARE_SRCDIR
        string "Trusted Firmware for Arm Source Directory"
        default ""
        help
          Directory to the source code of Arm Trusted Firmware.

config BR2_UBOOT_SRCDIR
        string "U-Boot Source Directory"
        default ""
        help
          Directory to the source code of U-Boot.

config BR2_OPTEE_OS_SRCDIR
        string "optee-os Source Directory"
        default ""
        help
          Directory to the source code of optee-os.

config BR2_LINUX_SRCDIR
        string "Linux Source Directory"
        default ""
        help
          Directory to the source code of Linux.

endmenu

source "$BR2_EXTERNAL_EXTPACK_PATH/package/lvgl/Config.in"
source "$BR2_EXTERNAL_EXTPACK_PATH/package/airplay/Config.in"
source "$BR2_EXTERNAL_EXTPACK_PATH/package/autologin/Config.in"
```

## package/autologin/Config.in
```kconfig
config BR2_PACKAGE_AUTOLOGIN
	bool "autologin"
	if BR2_PACKAGE_AUTOLOGIN
		config BR2_PACKAGE_AUTOLOGIN_WITHOUT_PASSWORD
			bool "without typing a user name or password"
	endif
```
